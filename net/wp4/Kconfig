## net/wp4/Kconfig
```kconfig
#
# WP4 P4 Driver
#

config WP4
	tristate "WP4 P4 Driver"
	default m
	
	---help---
	  WP4 P4 Driver

	  To compile this driver as a module, choose M here: the
	  module will be called lapb.  If unsure, say N.
```
